## main/Kconfig.projbuild
```kconfig
menu "Custom Leak Detection Configuration"

    config MQTT_BROKER_URL
        string "MQTT Broker URL"
        default "mqtts://irrigo.xyz:8883"
        help
            Set the URL of the MQTT broker (e.g., mqtt://192.168.1.100).

endmenu
```
